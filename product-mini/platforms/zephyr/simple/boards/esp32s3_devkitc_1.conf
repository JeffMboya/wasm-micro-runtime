## product-mini/platforms/zephyr/simple/boards/esp32s3_devkitc_1.conf
```kconfig
# General Zephyr Settings
CONFIG_MAIN_STACK_SIZE=8192
CONFIG_HEAP_MEM_POOL_SIZE=16384

# Enable UART for logging
CONFIG_UART_CONSOLE=y
CONFIG_LOG=y
CONFIG_LOG_BACKEND_UART=y
CONFIG_SERIAL=y

# Memory Management
CONFIG_SYS_HEAP_ALLOC=y
CONFIG_NEWLIB_LIBC=y
CONFIG_NEWLIB_LIBC_FLOAT_PRINTF=y

# Threading
CONFIG_THREAD_STACK_INFO=y

# WAMR-Specific Settings
CONFIG_WASM_GLOBAL_HEAP_SIZE=131072  # Global heap size for WAMR
CONFIG_WASM_APP_STACK_SIZE=8192      # Application stack size for WASM
```
